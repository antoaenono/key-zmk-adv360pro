#define VERSION_MACRO
macro_ver: macro_ver {
compatible = "zmk,behavior-macro";
#binding-cells = <0>;
bindings = <&kp N2>, <&kp N0>, <&kp N2>, <&kp N5>, <&kp N0>, <&kp N9>, <&kp N2>, <&kp N3>, <&kp MINUS>, <&kp V>, <&kp N3>, <&kp DOT>, <&kp N0>, <&kp MINUS>, <&kp N8>, <&kp N8>, <&kp D>, <&kp N3>, <&kp A>, <&kp E>, <&kp N7>, <&kp MINUS>, <&kp C>, <&kp L>, <&kp I>, <&kp Q>, <&kp U>, <&kp E>, <&kp RET>;
};
